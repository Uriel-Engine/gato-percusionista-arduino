/*
  ==========================================================
  Gato percusionista  
  Autor: Uriel Engine
  Fecha: 25/Abril/2026
  ==========================================================
  - Arduino UNO
  - 2 Modulos de sensor touch
  - OLED 128x64 
  - Buzzer pasivo 
  ==========================================================
*/

#include <Wire.h>
#include <Adafruit_GFX.h>
#include <Adafruit_SSD1306.h>

// ================= OLED =================
#define SCREEN_WIDTH 128
#define SCREEN_HEIGHT 64
Adafruit_SSD1306 display(SCREEN_WIDTH, SCREEN_HEIGHT, &Wire, -1);

// ================= PINES =================
#define TOUCH1 2
#define TOUCH2 3
#define BUZZER 9

// ================= TIEMPOS =================
#define SOUND_DURATION 500      // ms
#define COMBO_TOLERANCE 80      // ms para detectar doble toque

// ================= FRECUENCIAS =================
#define FREQ_LOW 250
#define FREQ_HIGH 500
#define FREQ_COMBO 750

// ================= ESTADOS =================
enum State {
  IDLE,
  TOUCH_1,
  TOUCH_2,
  BOTH
};

State currentState = IDLE;
State lastState = IDLE;

// ================= CONTROL SONIDO =================
unsigned long soundStart = 0;
bool soundPlayed = false;

// ================= CONTROL DOBLE TOUCH =================
unsigned long firstTouchTime = 0;
bool waitingCombo = false;

// ================= BITMAPS (PLACEHOLDER) =================
const unsigned char img1[] PROGMEM = { 
  0x00, 0x00, 0x00, 0x00, 0x00, 0x00, 0x00, 0x00, 0x00, 0x00, 0x00, 0x00, 0x00, 0x00, 0x00, 0x00, 
	0x00, 0x00, 0x00, 0x00, 0x00, 0x00, 0x00, 0x00, 0x00, 0x00, 0x00, 0x00, 0x00, 0x00, 0x00, 0x00, 
	0x00, 0x00, 0x00, 0x00, 0x00, 0x00, 0x00, 0x00, 0x00, 0x00, 0x00, 0x00, 0x00, 0x00, 0x00, 0x00, 
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	0xff, 0xff, 0xff, 0xff, 0xff, 0xff, 0xff, 0xff, 0xf8, 0x7f, 0xfb, 0xff, 0xff, 0xff, 0xff, 0xff
 };
const unsigned char img2[] PROGMEM = { 
  0x00, 0x00, 0x00, 0x00, 0x00, 0x00, 0x00, 0x00, 0x00, 0x00, 0x00, 0x00, 0x00, 0x00, 0x00, 0x00, 
	0x00, 0x00, 0x00, 0x00, 0x00, 0x00, 0x00, 0x00, 0x00, 0x00, 0x00, 0x00, 0x00, 0x00, 0x00, 0x00, 
	0x00, 0x00, 0x00, 0x00, 0x00, 0x00, 0x00, 0x01, 0x00, 0x00, 0x00, 0x00, 0x00, 0x00, 0x00, 0x00, 
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	0x00, 0x00, 0x00, 0x00, 0x00, 0x00, 0x00, 0x00, 0x00, 0x00, 0x00, 0x00, 0x00, 0x00, 0x00, 0x00
 };
const unsigned char img3[] PROGMEM = { 
  0x00, 0x00, 0x00, 0x00, 0x00, 0x00, 0x00, 0x00, 0x00, 0x00, 0x00, 0x00, 0x00, 0x00, 0x00, 0x00, 
	0x00, 0x00, 0x00, 0x00, 0x00, 0x00, 0x00, 0x00, 0x00, 0x00, 0x00, 0x00, 0x00, 0x00, 0x00, 0x00, 
	0x00, 0x00, 0x00, 0x00, 0x00, 0x00, 0x00, 0x00, 0x00, 0x00, 0x00, 0x00, 0x00, 0x00, 0x00, 0x00, 
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	0x00, 0x00, 0x00, 0x00, 0x00, 0x00, 0x00, 0x00, 0x00, 0x00, 0x00, 0x00, 0x00, 0x00, 0x00, 0x00
 };
const unsigned char img4[] PROGMEM = { 
  0x00, 0x00, 0x00, 0x00, 0x00, 0x00, 0x00, 0x00, 0x00, 0x00, 0x00, 0x00, 0x00, 0x00, 0x00, 0x00, 
	0x00, 0x00, 0x00, 0x00, 0x00, 0x00, 0x00, 0x00, 0x00, 0x00, 0x00, 0x00, 0x00, 0x00, 0x00, 0x00, 
	0x00, 0x00, 0x00, 0x00, 0x00, 0x00, 0x00, 0x00, 0x80, 0x00, 0x00, 0x00, 0x00, 0x00, 0x00, 0x00, 
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	0x00, 0x00, 0x00, 0x00, 0x00, 0x00, 0x00, 0x00, 0x00, 0x00, 0x00, 0x00, 0x00, 0x00, 0x00, 0x00
 };

// ================= FUNCIONES =================

void drawImage(const unsigned char *img) {
  display.clearDisplay();
  display.drawBitmap(0, 0, img, 128, 64, WHITE);
  display.display();
}

void playSound(int freq) {
  tone(BUZZER, freq);
  soundStart = millis();
  soundPlayed = true;
}

void updateSound() {
  if (soundPlayed && millis() - soundStart >= SOUND_DURATION) {
    noTone(BUZZER);
    soundPlayed = false;
  }
}

// ================= SETUP =================
void setup() {
  pinMode(TOUCH1, INPUT);
  pinMode(TOUCH2, INPUT);
  pinMode(BUZZER, OUTPUT);

  display.begin(SSD1306_SWITCHCAPVCC, 0x3C);
  display.clearDisplay();

  drawImage(img1);
}

// ================= LOOP =================
void loop() {

  bool t1 = digitalRead(TOUCH1);
  bool t2 = digitalRead(TOUCH2);

  unsigned long now = millis();

  // ================= DETECCIÓN CON TOLERANCIA =================
  if (t1 || t2) {
    if (!waitingCombo) {
      waitingCombo = true;
      firstTouchTime = now;
    }

    if (now - firstTouchTime > COMBO_TOLERANCE) {
      if (t1 && t2) currentState = BOTH;
      else if (t1) currentState = TOUCH_1;
      else if (t2) currentState = TOUCH_2;
    }
  } else {
    currentState = IDLE;
    waitingCombo = false;
  }

  // ================= CAMBIO DE ESTADO =================
  if (currentState != lastState) {

    switch (currentState) {

      case IDLE:
        drawImage(img1);
        noTone(BUZZER);
        soundPlayed = false;
        break;

      case TOUCH_1:
        drawImage(img2);
        playSound(FREQ_LOW);
        break;

      case TOUCH_2:
        drawImage(img3);
        playSound(FREQ_HIGH);
        break;

      case BOTH:
        drawImage(img4);
        playSound(FREQ_COMBO);
        break;
    }

    lastState = currentState;
  }

  // ================= CONTROL DURACIÓN SONIDO =================
  updateSound();
}
